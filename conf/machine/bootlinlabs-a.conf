## conf/machine/bootlinlabs-a.conf
```bitbake
require conf/machine/include/bootlinlabs.inc

STM32MP_DT_FILES_SDCARD = "stm32mp157a-dk1"
```

## conf/machine/bootlinlabs-d.conf
```bitbake
require conf/machine/include/bootlinlabs.inc

STM32MP_DT_FILES_SDCARD = "stm32mp157d-dk1"
```

## conf/machine/include/bootlinlabs.inc
```bitbake
require conf/machine/include/st-machine-common-stm32mp.inc
require conf/machine/include/st-machine-providers-stm32mp.inc

DEFAULTTUNE = "cortexa7thf-neon-vfpv4"
require conf/machine/include/arm/armv7a/tune-cortexa7.inc

UBOOT_CONFIG = "trusted_stm32mp15"

MACHINE_FEATURES += "m4copro"

MACHINEOVERRIDES:prepend = "bootlinlabs:"
```
